// Fontes vetoriais suavizadas para os pacotes de mostrador (só dígitos, ':' e espaço).
// Contornos com as curvas convertidas em segmentos, gerados a partir dos TTF; célula de 720
// unidades de altura (do topo dos dígitos à linha de base), y para baixo.
// Preenchimento em inteiros pela regra não-zero (fontes variáveis têm contornos sobrepostos),
// 4 sub-linhas por linha e cobertura de borda em 1/16 px; desenhado linha a linha por blit.
#include "ui_kit.h"

// Outfit SemiBold (The Outfit Project Authors, SIL Open Font License 1.1); dígitos tabulares
static const int16_t OUTFIT_PT[737][2] PROGMEM = {
  {303, 720}, {271, 718}, {240, 713}, {210, 704}, {181, 691}, {154, 675}, {128, 656}, {105, 634}, {84, 608}, {65, 580},
  {48, 549}, {34, 515}, {23, 479}, {15, 441}, {10, 401}, {9, 359}, {10, 317}, {15, 277}, {23, 239}, {34, 203},
  {48, 170}, {64, 139}, {83, 111}, {104, 86}, {127, 64}, {153, 45}, {180, 29}, {208, 16}, {237, 7}, {268, 2},
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  {218, 315}, {221, 337}, {218, 359}, {211, 379}, {198, 396}, {181, 409}, {162, 417},
};
static const uint16_t OUTFIT_CEND[26] PROGMEM = {60, 108, 112, 116, 172, 177, 245, 250, 255, 259, 264, 268, 341, 346, 350, 404, 440, 444, 449, 539, 575, 599, 653, 689, 713, 737};
static const uint8_t OUTFIT_GLYPH[12] PROGMEM = {0, 2, 4, 6, 9, 12, 15, 17, 19, 22, 24, 26};
static const uint16_t OUTFIT_ADV[11] PROGMEM = {601, 601, 601, 601, 601, 601, 601, 601, 601, 601, 279};

// Righteous (Astigmatic, SIL Open Font License 1.1); dígitos tabulares
static const int16_t RIGHTEOUS_PT[840][2] PROGMEM = {
  {449, 361}, {447, 318}, {443, 280}, {435, 246}, {425, 217}, {411, 193}, {390, 169}, {366, 152}, {338, 141}, {306, 138},
  {275, 141}, {247, 151}, {223, 168}, {202, 192}, {189, 216}, {179, 245}, {171, 279}, {167, 318}, {166, 361}, {167, 404},
  {171, 442}, {179, 476}, {189, 505}, {202, 529}, {223, 553}, {247, 570}, {275, 581}, {306, 584}, {328, 583}, {348, 578},
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  {103, 578}, {119, 573}, {135, 572}, {151, 573}, {166, 578}, {180, 586}, {192, 595}, {202, 607}, {209, 621}, {214, 636},
};
static const uint16_t RIGHTEOUS_CEND[17] PROGMEM = {40, 108, 114, 184, 261, 275, 327, 410, 458, 464, 565, 597, 645, 728, 776, 808, 840};
static const uint8_t RIGHTEOUS_GLYPH[12] PROGMEM = {0, 2, 3, 4, 5, 6, 7, 9, 10, 13, 15, 17};
static const uint16_t RIGHTEOUS_ADV[11] PROGMEM = {612, 612, 612, 612, 612, 612, 612, 612, 612, 612, 269};

const VecFont VF_OUTFIT = {OUTFIT_PT, OUTFIT_CEND, OUTFIT_GLYPH, OUTFIT_ADV};
const VecFont VF_RIGHTEOUS = {RIGHTEOUS_PT, RIGHTEOUS_CEND, RIGHTEOUS_GLYPH, RIGHTEOUS_ADV};

// Outfit SemiBold com letras (texto dos mostradores): gerada por sim/fontgen.js com TEXTO=1, tolerância 14
static const int16_t OUTFIT_TXT_PT[2653][2] PROGMEM = {
  {310, 405}, {45, 405}, {45, 314}, {310, 314}, {138, 556}, {43, 556}, {378, 15}, {473, 15}, {376, 563}, {356, 562},
  {337, 557}, {320, 548}, {304, 537}, {290, 524}, {279, 508}, {271, 491}, {266, 472}, {264, 452}, {266, 432}, {271, 413},
  {279, 396}, {290, 380}, {304, 367}, {319, 356}, {337, 348}, {355, 343}, {376, 341}, {396, 343}, {415, 348}, {433, 356},
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  {32, 184}, {337, 184}, {337, 242},
};
static const uint16_t OUTFIT_TXT_CEND[138] PROGMEM = {4, 8, 44, 60, 96, 112, 128, 144, 189, 225, 229, 233, 279,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 2648, 2653};
static const uint8_t OUTFIT_TXT_GLYPH[67] PROGMEM = {0, 0, 1, 6, 8, 10, 12, 14, 17, 20, 23, 25, 27,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 135, 138};
static const uint16_t OUTFIT_TXT_ADV[66] PROGMEM = {150, 355, 516, 216, 507, 282, 425, 423, 464, 425, 436, 403, 426,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 404, 358};
static const char OUTFIT_TXT_CHARS[] PROGMEM = " -%:0123456789ABCDEFGHIJKLMNOPQRSTUVWXYZabcdefghijklmnopqrstuvwxyz";
const VecFont VF_OUTFIT_TXT = {OUTFIT_TXT_PT, OUTFIT_TXT_CEND, OUTFIT_TXT_GLYPH, OUTFIT_TXT_ADV, OUTFIT_TXT_CHARS};

static int vfGlyph(const VecFont &f, char ch) {
  if (!f.chars) return ch >= '0' && ch <= '9' ? ch - '0' : ch == ':' ? 10 : -1;
  for (int i = 0;; i++) {  // fonte de texto: posição na lista de caracteres
    char c = pgm_read_byte(&f.chars[i]);
    if (!c) return -1;
    if (c == ch) return i;
  }
}
static int vfAdv(const VecFont &f, char ch, int h) {
  int g = vfGlyph(f, ch);
  return (g >= 0 ? pgm_read_word(&f.adv[g]) : pgm_read_word(&f.adv[0]) / 2) * h / 720;
}

int vecWidth(const VecFont &f, const char *s, int h) {
  int w = 0;
  for (; *s; s++) w += vfAdv(f, *s, h);
  return w;
}

static void vfSpan(uint8_t *cov, int n, int a, int b) {
  if (a < 0) a = 0;
  if (b > n * 16) b = n * 16;
  if (b <= a) return;
  int ia = a >> 4, ib = b >> 4;
  if (ia == ib) {
    cov[ia] += b - a;
    return;
  }
  cov[ia] += 16 - (a & 15);
  for (int i = ia + 1; i < ib; i++) cov[i] += 16;
  if (ib < n) cov[ib] += b & 15;
}

void vecText(const VecFont &f, int x, int y, int h, const char *s, uint16_t fg, uint16_t bg) {
  int W = vecWidth(f, s, h);
  if (W > 240) W = 240;
  if (W <= 0 || h <= 0) return;
  // buffers só durante o desenho (RAM fixa é escassa: o GIF do álbum precisa de ~24 KB contíguos)
  uint8_t *cov = (uint8_t *)malloc(W * 3 + 2);  // cobertura (W) + linha RGB565 alinhada (2W)
  if (!cov) return;
  uint16_t *row = (uint16_t *)(cov + ((W + 1) & ~1));
  uint16_t pal[17];
  for (int i = 0; i <= 16; i++) pal[i] = mix16(bg, fg, i);
  for (int r = 0; r < h; r++) {
    memset(cov, 0, W);
    int ox = 0;
    for (const char *p = s; *p; ox += vfAdv(f, *p, h), p++) {
      int g = vfGlyph(f, *p);
      if (g < 0) continue;
      int c0 = pgm_read_byte(&f.glyph[g]), c1 = pgm_read_byte(&f.glyph[g + 1]);
      for (int j = 0; j < 4; j++) {
        int sy = (int)((r + (j + 0.5f) / 4) * 720 / h);
        int xs[32], n = 0;  // x em 1/16 de unidade, *2 + sentido (1 = descendo)
        for (int c = c0; c < c1; c++) {
          int s0 = c ? pgm_read_word(&f.cend[c - 1]) : 0, e = pgm_read_word(&f.cend[c]);
          for (int i = s0; i < e; i++) {
            int k = i + 1 < e ? i + 1 : s0;
            int ay = (int16_t)pgm_read_word(&f.pt[i][1]), by = (int16_t)pgm_read_word(&f.pt[k][1]);
            if ((ay <= sy && sy < by) || (by <= sy && sy < ay)) {
              int ax = (int16_t)pgm_read_word(&f.pt[i][0]), bx = (int16_t)pgm_read_word(&f.pt[k][0]);
              if (n < 32) xs[n++] = (ax * 16 + (sy - ay) * (bx - ax) * 16 / (by - ay)) * 2 + (ay < by);
            }
          }
        }
        for (int i = 1; i < n; i++)
          for (int k = i; k > 0 && xs[k] < xs[k - 1]; k--) {
            int t = xs[k];
            xs[k] = xs[k - 1];
            xs[k - 1] = t;
          }
        int wn = 0;
        for (int k = 0; k + 1 < n; k++) {
          wn += (xs[k] & 1) ? 1 : -1;
          if (wn) vfSpan(cov, W, ox * 16 + (xs[k] >> 1) * h / 720, ox * 16 + (xs[k + 1] >> 1) * h / 720);
        }
      }
    }
    for (int i = 0; i < W; i++) row[i] = pal[(cov[i] > 64 ? 64 : cov[i]) / 4];
    blit(x, y + r, row, W, 1);
  }
  free(cov);
}
